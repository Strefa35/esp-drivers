## components/tsl2561/Kconfig
```kconfig
menu "TSL256X driver"

    config TSL256X_ENABLE
        bool "Enable CFG Controller"
        default "n"
        help
            Enable TSL256X driver

    choice TSL256X_LOG_LEVEL
        bool "Log level"
        default TSL256X_LOG_DEFAULT_LEVEL_INFO
        help
            Specify how much output to see in logs by default.

        config TSL256X_LOG_DEFAULT_LEVEL_NONE
            bool "No output"
        config TSL256X_LOG_DEFAULT_LEVEL_ERROR
            bool "Error"
        config TSL256X_LOG_DEFAULT_LEVEL_WARN
            bool "Warning"
        config TSL256X_LOG_DEFAULT_LEVEL_INFO
            bool "Info"
        config TSL256X_LOG_DEFAULT_LEVEL_DEBUG
            bool "Debug"
        config TSL256X_LOG_DEFAULT_LEVEL_VERBOSE
            bool "Verbose"
    endchoice

    config TSL256X_LOG_LEVEL
        int
        default 0 if TSL256X_LOG_DEFAULT_LEVEL_NONE
        default 1 if TSL256X_LOG_DEFAULT_LEVEL_ERROR
        default 2 if TSL256X_LOG_DEFAULT_LEVEL_WARN
        default 3 if TSL256X_LOG_DEFAULT_LEVEL_INFO
        default 4 if TSL256X_LOG_DEFAULT_LEVEL_DEBUG
        default 5 if TSL256X_LOG_DEFAULT_LEVEL_VERBOSE

endmenu
```
